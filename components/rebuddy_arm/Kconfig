## components/rebuddy_arm/Kconfig
```kconfig
menu "reBuddy arm components"
    config REBUDDY_ARM_DAILY_CONTROL
        bool "Enable screen-driven daily arm control"
        default n
        help
            Active CAN1 with native RS motor service and gravity compensation.
            Boot shows SLEEP without enabling. Click the wake arrow to execute WAKE.
            Requires the exported calibration and independent support.
    config REBUDDY_ARM_DANCE_CONTROL
        bool "Enable touch and serial Dance choreography"
        default n
        depends on REBUDDY_ARM_DAILY_CONTROL
        help
            Ten offline-checked trajectories, seeded random selection and C2 joins.
            Touch playback and serial commands share the Daily motor task.
            Boot never starts motion.
            No Dance GIF synchronization. Requires current calibration/support.
    config REBUDDY_ARM_MONITOR
        bool "Start CAN1 in passive listen-only mode"
        default n
        depends on !REBUDDY_ARM_DAILY_CONTROL
        help
            Receives existing RS status broadcasts at 1 Mbps. Sends no frames
            or ACKs and does not discover, configure or enable motors.
            Another active CAN node is needed to acknowledge broadcasts.
            Disabled by default: both transceivers remain in standby.
endmenu
```

## main/Kconfig.projbuild
```kconfig
menu "reBuddy desktop companion"
    config REBUDDY_LCD_SPI_MHZ
        int "LCD SPI clock (MHz)"
        range 20 40
        default 40
        help
            40 MHz reduces pixel transfer time. If the panel or wiring shows
            corruption, use 20 MHz and rebuild.
    config REBUDDY_DISPLAY_STATS
        bool "Log display rendering and transfer statistics every 5 seconds"
        default y
        help
            Counts actual LVGL redraws and queued pixels. An unchanged scene
            intentionally has fewer redraws; this is not the LCD scanout rate.
    config REBUDDY_DROWSY_SECONDS
        int "Idle time before drowsiness (seconds)"
        range 5 600
        default 30
    config REBUDDY_SLEEP_SECONDS
        int "Idle time before dozing (seconds; must exceed drowsy time)"
        range 10 1800
        default 60
endmenu
```

## sdkconfig.defaults
```kconfig
CONFIG_IDF_TARGET="esp32c5"
CONFIG_COMPILER_OPTIMIZATION_SIZE=y
CONFIG_FREERTOS_PLACE_FUNCTIONS_INTO_FLASH=y
CONFIG_ESP_CONSOLE_USB_SERIAL_JTAG=y
# CONFIG_ESP_CONSOLE_UART_DEFAULT is not set
CONFIG_ESP_CONSOLE_SECONDARY_NONE=y
CONFIG_ESPTOOLPY_FLASHSIZE_8MB=y
CONFIG_PARTITION_TABLE_CUSTOM=y
CONFIG_PARTITION_TABLE_CUSTOM_FILENAME="partitions.csv"
# Board profile: 8 MiB Quad PSRAM at 40 MHz.
CONFIG_SPIRAM=y
CONFIG_SPIRAM_MODE_QUAD=y
CONFIG_SPIRAM_SPEED_40M=y
CONFIG_SPIRAM_BOOT_HW_INIT=y
CONFIG_SPIRAM_BOOT_INIT=y
CONFIG_SPIRAM_MEMTEST=y
# CONFIG_SPIRAM_IGNORE_NOTFOUND is not set
CONFIG_SPIRAM_USE_CAPS_ALLOC=y
# CONFIG_SPIRAM_USE_MALLOC is not set
CONFIG_LV_USE_CLIB_SPRINTF=y
CONFIG_LV_MEM_SIZE_KILOBYTES=128
CONFIG_LV_DEF_REFR_PERIOD=20
CONFIG_REBUDDY_LCD_SPI_MHZ=40
CONFIG_REBUDDY_DISPLAY_STATS=y
CONFIG_LV_FONT_MONTSERRAT_12=y
CONFIG_LV_USE_ARC=y
# CONFIG_LV_BUILD_EXAMPLES is not set
# CONFIG_LV_BUILD_DEMOS is not set
# CONFIG_LV_USE_THORVG_INTERNAL is not set
# CONFIG_LV_USE_ANIMIMG is not set
# CONFIG_LV_USE_CANVAS is not set
# CONFIG_LV_USE_CHART is not set
# CONFIG_LV_USE_KEYBOARD is not set
# CONFIG_LV_USE_TABLE is not set
# CONFIG_LV_USE_TEXTAREA is not set
# CONFIG_LV_USE_SPINBOX is not set
# Screen preview keeps CAN transceivers in standby; no motion backend is linked.
CONFIG_REBUDDY_DROWSY_SECONDS=30
CONFIG_REBUDDY_SLEEP_SECONDS=60
```
